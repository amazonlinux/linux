## arch/arm64/Kconfig.debug
```kconfig
# SPDX-License-Identifier: GPL-2.0-only

config PID_IN_CONTEXTIDR
	bool "Write the current PID to the CONTEXTIDR register"
	help
	  Enabling this option causes the kernel to write the current PID to
	  the CONTEXTIDR register, at the expense of some additional
	  instructions during context switch. Say Y here only if you are
	  planning to use hardware trace tools with this kernel.

config DEBUG_EFI
	depends on EFI && DEBUG_INFO
	bool "UEFI debugging"
	help
	  Enable this option to include EFI specific debugging features into
	  the kernel that are only useful when using a debug build of the
	  UEFI firmware

config ARM64_RELOC_TEST
	depends on m
	tristate "Relocation testing module"

choice
    prompt "Choose kernel unwinder"
    default UNWINDER_FRAME_POINTER
    help
      This determines which method will be used for unwinding kernel stack
      traces for panics, oopses, bugs, warnings, perf, /proc/<pid>/stack,
      livepatch, lockdep, and more.

config UNWINDER_FRAME_POINTER
    bool "Frame pointer unwinder"
    select FRAME_POINTER
    help
      This option enables the frame pointer unwinder for unwinding kernel
      stack traces.

      The unwinder itself is fast and it uses less RAM than the ORC
      unwinder, but the kernel text size will grow by ~3% and the kernel's
      overall performance will degrade by roughly 5-10%.

endchoice

source "drivers/hwtracing/coresight/Kconfig"
```

## crypto/fips140/Kconfig
```kconfig
config CRYPTO_FIPS140_EXTMOD
	bool "FIPS 140 compliant algorithms as a kernel module"
	depends on CRYPTO && (X86_64 || ARM64) && MODULES
	select CRYPTO_FIPS
	help
	  This option enables building a kernel module that contains
	  copies of crypto algorithms that are built in a way that
	  complies with the FIPS 140 standard.

	  The module registers the algorithms it contains with the
	  kernel crypto API, and the kernel crypto API's FIPS 140 mode
	  can be enabled to restrict crypto algorithm usage to only
	  those provided by this module.

	  If unsure, say N.
config CRYPTO_FIPS140_HMAC_KEY
	string "FIPS 140-3 external module HMAC key"
	depends on CRYPTO_FIPS140_EXTMOD
	default "The quick brown fox jumps over the lazy dog while the sphinx of black quartz judges my vow"
	help
	  This is the HMAC key used to build and verify the integrity of
	  the FIPS module.

	  Must be at least 80 characters.
config CRYPTO_FIPS140_EXTMOD_SOURCE
	bool "Use external FIPS module source"
	depends on CRYPTO_FIPS140_EXTMOD
	default n
	help
	  Use pre-built FIPS modules from an external build directory instead
	  of freshly built modules from the current kernel build.
	  
	  If N, the kernel uses freshly generated crypto modules from the
	  current build directory:
	    - crypto/fips140/fips140.ko
	    - crypto/aes.ko
	    - crypto/sha256.ko
	  
	  If Y, pre-built modules from fips140_build/ are used:
	    - fips140_build/crypto/fips140/fips140.ko
	    - fips140_build/crypto/aes.ko
	    - fips140_build/crypto/sha256.ko
	  
	  If unsure, say N.
config CRYPTO_FIPS140_DUAL_VERSION
	bool "Enable dual crypto versions for FIPS and regular modes"
	depends on CRYPTO_FIPS140_EXTMOD && CRYPTO_FIPS140_EXTMOD_SOURCE
	default n
	help
	  Enable keeping two crypto module versions in the same kernel build
	  for boot-time switching based on FIPS mode status. This allows:
	  - Non-FIPS users: Get latest crypto algorithms built from current
	    kernel sources for optimal performance and security features
	  - FIPS users: Get pre-compiled certified crypto modules that have
	    undergone formal validation and certification processes

	  When enabled:

	  For core fips140.ko:
	  - FIPS mode: Uses certified module from CRYPTO_FIPS140_EXTMOD_SOURCE
	  - Regular mode: Uses freshly built kernel crypto implementation

	  For modular algorithms (e.g., aes.ko), they are not duplicated
	  automatically. Either make them built-in to be included into
	  fips140.ko for automatic duplication, or require OS utilities such
	  as `modprobe` to correctly isolate modular cryptos in filesystems.

	  If unsure, say N.
```

## drivers/amazon/Kconfig
```kconfig
#
# Amazon driver updates configuration
#

config AMAZON_DRIVER_UPDATES
	bool "Amazon Driver Updates"
	default y
	depends on PCI || EXPERIMENTAL
	---help---
	 Amazon driver updates includes out-of-tree drivers and/or modifeid
	 versions of the drivers present in the stable kernel tree.

if AMAZON_DRIVER_UPDATES

endif # AMAZON_DRIVER_UPDATES
```

## drivers/amazon/media/v4l2-loopback/Kconfig
```kconfig
# v4l2loopback config states

config V4L2_LOOPBACK
    tristate "Enable v4l2-loopback"
    depends on VIDEO_DEV
    help
      Say M here to enable v4l2-loopback as module.
```

## drivers/amazon/scsi/smartpqi/Kconfig
```kconfig
#Smart PQI Driver
config AMAZON_SCSI_SMARTPQI
	tristate "Microsemi PQI Driver"
	depends on PCI && SCSI && !S390
	select SCSI_SAS_ATTRS
	select RAID_ATTRS
	help
	This driver supports Microsemi PQI controllers.

	<http://www.microsemi.com>

	To compile this driver as a module, choose M here: the
	module will be called smartpqi.

	Note: the aacraid driver will not manage a smartpqi
		controller. You need to enable smartpqi for smartpqi
		controllers. For more information, please see
		Documentation/scsi/smartpqi.rst	  
```

## drivers/scsi/mpi3mr/Kconfig
```kconfig
# SPDX-License-Identifier: GPL-2.0-or-later

config SCSI_MPI3MR
	tristate "Broadcom MPI3 Storage Controller Device Driver"
	depends on PCI && SCSI
	help
	This driver supports Broadcom's Unified MPI3 based Storage & RAID Controllers.
```

## drivers/staging/lustrefsx/Kconfig
```kconfig
source "drivers/staging/lustrefsx/libcfs/Kconfig"
source "drivers/staging/lustrefsx/lnet/Kconfig"
source "drivers/staging/lustrefsx/lustre/Kconfig"
```

## drivers/staging/lustrefsx/lnet/Kconfig
```kconfig
config LUSTREFSX_LNET
	tristate "Lustre networking subsystem (LNet)"
	select LUSTREFSX_LIBCFS
	depends on m
	depends on INET
	help
	  The Lustre network layer, also known as LNet, is a networking abstaction
	  level API that was initially created to allow Lustre Filesystem to utilize
	  very different networks like tcp and ib verbs in a uniform way. In the
	  case of Lustre routers only the LNet layer is required. Lately other
	  projects are also looking into using LNet as their networking API as well.

config LUSTREFSX_LNET_SELFTEST
	tristate "Lustre networking self testing"
	depends on m
	depends on LUSTREFSX_LNET
	help
	  Choose Y here if you want to do lnet self testing. To compile this
	  as a module, choose M here: the module will be called lnet_selftest.

	  If unsure, say N.

	  See also http://wiki.lustre.org/

config LUSTREFSX_LNET_XPRT_IB
	tristate "LNET infiniband support"
	depends on m
	depends on LUSTREFSX_LNET && INFINIBAND && INFINIBAND_ADDR_TRANS
	help
	  This option allows the LNET users to use infiniband as an
	  RDMA-enabled transport.

	  To compile this as a kernel module, choose M here and it will be
	  called ko2iblnd.

	  If unsure, say N.
```

## drivers/virt/Kconfig
```kconfig
# SPDX-License-Identifier: GPL-2.0-only
#
# Virtualization support drivers
#

menuconfig VIRT_DRIVERS
	bool "Virtualization drivers"
	help
	  Say Y here to get to see options for device drivers that support
	  virtualization environments.

	  If you say N, all options in this submenu will be skipped and disabled.

if VIRT_DRIVERS

config VMGENID
	tristate "Virtual Machine Generation ID driver"
	depends on ACPI && SYSGENID
	help
	  The driver uses the hypervisor provided Virtual Machine Generation ID
	  to drive the system generation counter mechanism exposed by sysgenid.
	  The vmgenid changes on VM snapshots or VM cloning. The hypervisor
	  provided 128-bit vmgenid is also used as device randomness to improve
	  kernel entropy following VM snapshot events.

	  To compile this driver as a module, choose M here: the
	  module will be called vmgenid.

config FSL_HV_MANAGER
	tristate "Freescale hypervisor management driver"
	depends on FSL_SOC
	select EPAPR_PARAVIRT
	help
          The Freescale hypervisor management driver provides several services
	  to drivers and applications related to the Freescale hypervisor:

          1) An ioctl interface for querying and managing partitions.

          2) A file interface to reading incoming doorbells.

          3) An interrupt handler for shutting down the partition upon
	     receiving the shutdown doorbell from a manager partition.

          4) A kernel interface for receiving callbacks when a managed
	     partition shuts down.

source "drivers/virt/vboxguest/Kconfig"

source "drivers/virt/nitro_enclaves/Kconfig"

source "drivers/virt/acrn/Kconfig"
endif
```

## net/lnet/lnet/Kconfig
```kconfig
config LUSTRE_LNET
	tristate "Lustre networking subsystem (LNet)"
	select LUSTRE_LIBCFS
	depends on m
	depends on INET
	help
	  The Lustre network layer, also known as LNet, is a networking abstaction
	  level API that was initially created to allow Lustre Filesystem to utilize
	  very different networks like tcp and ib verbs in a uniform way. In the
	  case of Lustre routers only the LNet layer is required. Lately other
	  projects are also looking into using LNet as their networking API as well.

config LUSTRE_LNET_SELFTEST
	tristate "Lustre networking self testing"
	depends on m
	depends on LUSTRE_LNET
	help
	  Choose Y here if you want to do lnet self testing. To compile this
	  as a module, choose M here: the module will be called lnet_selftest.

	  If unsure, say N.

	  See also http://wiki.lustre.org/

config LUSTRE_LNET_XPRT_IB
	tristate "LNET infiniband support"
	depends on m
	depends on LUSTRE_LNET && INFINIBAND && INFINIBAND_ADDR_TRANS
	default LUSTRE_LNET && INFINIBAND
	help
	  This option allows the LNET users to use infiniband as an
	  RDMA-enabled transport.

	  To compile this as a kernel module, choose M here and it will be
	  called ko2iblnd.

	  If unsure, say N.

config LUSTRE_LNET_EFALND
	tristate "LNET EFA support"
	depends on m
	depends on LUSTRE_LNET && AMAZON_EFA_INFINIBAND
	default LUSTRE_LNET && AMAZON_EFA_INFINIBAND
	help
	  This option allows the LNET users to use EFA as an
	  RDMA-enabled transport.

	  To compile this as a kernel module, choose M here and it will be
	  called kefalnd.
```
